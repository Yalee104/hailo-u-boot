// SPDX-License-Identifier: GPL-2.0
/*
 * dts file for Hailo Hailo10 SoC
 *
 * Copyright (c) 2019-2024 Hailo Technologies Ltd. All rights reserved.
 */

#include "hailo15-base.dtsi"

/delete-node/ &i2c_0;
/delete-node/ &i2c_2;
/delete-node/ &i2c_3;

&i2c_1 {
    status = "okay";
};

