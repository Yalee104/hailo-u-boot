## board/customized/cusboard/Kconfig
```kconfig
if TARGET_CUSBOARD

config SYS_BOARD
    default "cusboard"

config SYS_VENDOR
    default "customized"

config SYS_CONFIG_NAME
    default "cusboard"

endif
```

## configs/hailo10_m2_defconfig
```kconfig
CONFIG_ARM=y
CONFIG_ARCH_HAILO=y
CONFIG_TARGET_HAILO10_M2=y
CONFIG_DEFAULT_DEVICE_TREE="hailo10-m2"
CONFIG_SPI_FLASH_ISSI=y
CONFIG_SPI_FLASH_WINBOND=y
CONFIG_SPI_FLASH_MACRONIX=y
```

## configs/hailo15l_oregano_defconfig
```kconfig
CONFIG_ARM=y
CONFIG_ARCH_HAILO=y
CONFIG_TARGET_HAILO15L_OREGANO=y
CONFIG_DEFAULT_DEVICE_TREE="hailo15l-oregano"
CONFIG_SPI_FLASH_STMICRO=y
```

## configs/hailo15l_veloce_defconfig
```kconfig
CONFIG_ARM=y
CONFIG_ARCH_HAILO=y
CONFIG_TARGET_HAILO15L_VELOCE=y
CONFIG_DEFAULT_DEVICE_TREE="hailo15l-veloce"
# CONFIG_AUTOBOOT is not set
```
